/*
 *Programa conexión WiFi IoHT - Conexión y despliegue de información en pantalla OLED 
 *Descripción: En este programa usaremos el ESP32 y una pantalla OLED, conectaremos el dispositivo a una red WiFi
 *con ello podremos visualizar información de la intensidad de señal que nuestro dispositivo estara obteniendo
 *
 *Programa realizado por Angel Isidro - 12 enero 2021 - Versión 1 
 */
 
// Libreria para usar las propiedades de conexión WiFi
  #include <WiFi.h> 

// Libreria para usar las propiedades de la pantalla OLED
  #include <Adafruit_FeatherOLED.h> 

//Credenciales para poder conectarnos a la red-WiFi sustituya dentro de las comillas
  const char* ssid = "NOMBRE_DEL_WiFi"; // 
  const char* password = "CONTRASEÑA";
  Adafruit_FeatherOLED oled = Adafruit_FeatherOLED();

/*
  Los códigos que se encuentran representan el código necesario para representar una imagen BMP
  en nuestra pantalla OLED
*/
const unsigned char wfMax[] PROGMEM = {
  B11111110,B00000011,B00000000,
  B11111110,B00000011,B00000000,
  B10010010,B00000011,B00000000,
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  B00010110,B11011011,B00000000
};

const unsigned char wfMin[] PROGMEM = {
  B11111110,B00000000,B00000000,
  B11111110,B00000000,B00000000,
  B10010010,B00000000,B00000000,
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  B00010110,B00000000,B00000000
};



const unsigned char wfMed[] PROGMEM = {
  B11111110,B00000000,B00000000,
  B11111110,B00000000,B00000000,
  B10010010,B00000000,B00000000,
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  B00010110,B11000000,B00000000
};

const unsigned char wfOk[] PROGMEM = {
  B11111110,B00000000,B00000000,
  B11111110,B00000000,B00000000,
  B10010010,B00000000,B00000000,
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  B00010110,B11011000,B00000000
};


const unsigned char wfNo[] PROGMEM = {
  B11111110,B00000000,B00000000,
  B11111110,B00000000,B00000000,
  B10010010,B00000000,B00000000,
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  B00010110,B11000000,B00000000
};

const unsigned char TL[] PROGMEM = {
  0x00,0x00,0x00,0x00,0x00,0x00,0x00,0x00,0x00,0x00,0x00,0x00,0x00,0x00,0x00,0x00,
  0x00,0x00,0x00,0x00,0x00,0x00,0x00,0x00,0x00,0x00,0x00,0x00,0x00,0x00,0x00,0x00,
  0x00,0x00,0x00,0x00,0x00,0x00,0x00,0x00,0x00,0x00,0x00,0x00,0x00,0x00,0x00,0x00,
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  0x00,0x00,0x00,0x00,0x00,0x00,0x00,0x00,0x00,0x00,0x00,0x00,0x00,0x00,0x00,0x00
};


void setup() {
  // Iniciamos nuestro puerto Serial
  Serial.begin(115200);
  // Iniciamos nuestra pantalla OLED
  oled.init();
  /*
  Código necesario para hacer la conexión WiFi
  */
  Serial.print("Connecting to ");
  Serial.println(ssid);
  WiFi.mode(WIFI_STA);
  WiFi.begin(ssid, password);
  while (WiFi.status() != WL_CONNECTED) {
    delay(500);
    Serial.print(".");
  }
  Serial.println("");
  Serial.println("WiFi connected");
  Serial.println("IP address: ");
  Serial.println(WiFi.localIP());
  //Fin de la inicialización WiFi
  
  oled.clearDisplay(); // Limpiamos la pantalla OLED
  teslaInicio();  // Función para mostrar el logo de Tesla Lab al inicio 
  oled.clearDisplay();
  oled.println("WiFi connected");
  delay(1500);
  oled.clearDisplay();
  wifiInfo(); //Función para mostrar la información de nuestro  
  delay(3000);
}

void loop() {
  oled.clearDisplay();
  wfIntensidad();
  wifiInfo();
  delay(1000);
  

}

void wfIntensidad() {
  int intenWF = WiFi.RSSI();  
  Serial.println(intenWF);
  
  
  if(intenWF <= -71 ){ // Intensidad de señal baja
    oled.display();
    oled.drawBitmap(111 , -1 , wfMin , 17 , 9 , WHITE );
    oled.display();
    Serial.println("Intensidad Baja ");
  }else if((intenWF <= -61 ) && (intenWF >= -70 )){// Intensidad de señal media
    oled.display();
    oled.drawBitmap(111 , -1 , wfMed , 17 , 9 , WHITE );
    oled.display();
    Serial.println("Intensidad media");
  }
  
  if((intenWF <= -51 ) && (intenWF >= -60 )){// Intensidad de señal buena
    oled.display();
    oled.drawBitmap(111 , -1 , wfOk , 17 , 9 , WHITE );
    oled.display();
    Serial.println("Intensidad buena");
  } 
  
  if(intenWF >= -50 ){// Intensidad de señal Alta
    oled.display();
    oled.drawBitmap(111 , -1 , wfMax , 17 , 9 , WHITE );
    oled.display();
    Serial.println("Intensidad Alta ");
  }
  if(intenWF == -100){ // Sin Señal
    oled.display();
    oled.drawBitmap(111 , -1 , wfNo , 17 , 9 , WHITE );
    oled.display();
    Serial.println("Sin conexion");
    }
}

void teslaInicio(){
  oled.clearDisplay();
  oled.setCursor(0,0);
  oled.println("Inter. of Home Things");
  oled.display();
  oled.setTextSize(1);
  oled.drawBitmap(0 , 0 , TL , 128 , 64 , WHITE );
  oled.display();
  delay(5000);
}

void wifiInfo(){
  //oled.clearDisplay();
  oled.setCursor(0,9);
  oled.print("SSID: ");
  oled.println(ssid);
  oled.println("Direccion IP: ");
  oled.println(WiFi.localIP());
  oled.display();
  oled.setTextSize(1);
}
