/***************************************************************************
  This is a library for the BME680 gas, humidity, temperature & pressure sensor

  Designed specifically to work with the Adafruit BME680 Breakout
  ----> http://www.adafruit.com/products/3660

  These sensors use I2C or SPI to communicate, 2 or 4 pins are required
  to interface.

  Adafruit invests time and resources providing this open source code,
  please support Adafruit and open-source hardware by purchasing products
  from Adafruit!

  Written by Limor Fried & Kevin Townsend for Adafruit Industries.
  BSD license, all text above must be included in any redistribution
 ***************************************************************************/

#include <EasyBuzzer.h>
#include <Wire.h>
#include <SPI.h>
#include <Adafruit_FeatherOLED.h>
#include <Adafruit_Sensor.h>
#include <Adafruit_NeoPixel.h>
#include "Adafruit_BME680.h"
#include "bsec.h"


#define BME_SCK 13
#define BME_MISO 12
#define BME_MOSI 11
#define BME_CS 10

#define SEALEVELPRESSURE_HPA (1013.25)

#define buzzer 27

#define pinRelay 35

Adafruit_FeatherOLED oled = Adafruit_FeatherOLED();

Adafruit_BME680 bme; // I2C
//Adafruit_BME680 bme(BME_CS); // hardware SPI
//Adafruit_BME680 bme(BME_CS, BME_MOSI, BME_MISO,  BME_SCK);

#define PIXEL_PIN   14  // Digital IO pin connected to the NeoPixels.
#define PIXEL_COUNT 6  // Number of NeoPixels

//values for alarms
int TEMP_MAX = 33;
int TEMP_MIN = 15;

int HUME_MAX = 85;
int HUME_MIN = 30;

int SAQI_MAX = -999;
int SAQI_MIN = -999;

int WIFI_WARNING = -999;


double temp, hume, pres, sAQI = 0;

const int touch_treshold = 10;

#include "bsec.h" // Libreria BSEC de Bosch para BME680

//************** Funciones para el Sensor BME680 **************
//Declaración de funciones de ayuda
void checkIaqSensorStatus(void);
// Creamos un objeto con clase BSEC Software
Bsec iaqSensor;
String output, output2;


// Declare our NeoPixel strip object:
Adafruit_NeoPixel neopixelLEDs(PIXEL_COUNT, PIXEL_PIN, NEO_GRB + NEO_KHZ800);

/**
 * Made with Marlin Bitmap Converter
 * https://marlinfw.org/tools/u8glib/converter.html
 *
 * This bitmap from the file 'TL.bmp'
 */
const unsigned char TL[] PROGMEM = {
  0x00,0x00,0x00,0x00,0x00,0x00,0x00,0x00,0x00,0x00,0x00,0x00,0x00,0x00,0x00,0x00,
  0x00,0x00,0x00,0x00,0x00,0x00,0x00,0x00,0x00,0x00,0x00,0x00,0x00,0x00,0x00,0x00,
  0x00,0x00,0x00,0x00,0x00,0x00,0x00,0x00,0x00,0x00,0x00,0x00,0x00,0x00,0x00,0x00,
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  0x00,0x00,0x00,0x00,0x00,0x00,0x00,0x00,0x00,0x00,0x00,0x00,0x00,0x00,0x00,0x00
};


void setup() {


  Serial.begin(9600);         //Initialize serial port

  oled.init();                //Initialize OLED Display
  //oled.setBatteryVisible(true);

  oled.println("Starting ....");
  oled.display();

  EasyBuzzer.setPin(buzzer);  //Initialize buzzer
  
  //testingBuzzer();
  //testingRelay();

  while (!Serial);
  
  //Setup para el BME680
    Wire.begin(21,22);
    iaqSensor.begin(0x77, Wire);
    output = "\nBSEC library version " + String(iaqSensor.version.major) + "." + String(iaqSensor.version.minor) + "." + String(iaqSensor.version.major_bugfix) + "." + String(iaqSensor.version.minor_bugfix);
    Serial.println(output);
    checkIaqSensorStatus();
  bsec_virtual_sensor_t sensorList[10] = {
    BSEC_OUTPUT_RAW_TEMPERATURE,
    BSEC_OUTPUT_RAW_PRESSURE,
    BSEC_OUTPUT_RAW_HUMIDITY,
    BSEC_OUTPUT_RAW_GAS,
    BSEC_OUTPUT_IAQ,
    BSEC_OUTPUT_STATIC_IAQ,
    BSEC_OUTPUT_CO2_EQUIVALENT,
    BSEC_OUTPUT_BREATH_VOC_EQUIVALENT,
    BSEC_OUTPUT_SENSOR_HEAT_COMPENSATED_TEMPERATURE,
    BSEC_OUTPUT_SENSOR_HEAT_COMPENSATED_HUMIDITY,
  };
  iaqSensor.updateSubscription(sensorList, 10, BSEC_SAMPLE_RATE_LP);
  checkIaqSensorStatus();

  output = "Timestamp [ms], raw temperature [°C], pressure [hPa], raw relative humidity [%], gas [Ohm], IAQ, IAQ accuracy, temperature [°C], relative humidity [%], Static IAQ, CO2 equivalent, breath VOC equivalent";
  Serial.println(output);
  
  // Testing buzzer
  pinMode(buzzer, OUTPUT);

  //Initialize neopixels
  neopixelLEDs.begin(); // Initialize NeoPixel strip object (REQUIRED)
  neopixelLEDs.setBrightness(128);
  neopixelLEDs.show();  // Initialize all pixels to 'off'

  oled.clearDisplay();
  //oled.drawBitmap(0 , -21 , TL , 128 , 64 , WHITE );
  oled.setCursor(0,0);
  oled.println("Inter. of Home Things");
  oled.display();
  oled.setTextSize(1);
  oled.drawBitmap(0 , 0 , TL , 128 , 64 , WHITE );
  oled.display();
  delay(800);

}

int data_index = 0;

void loop() {

  output2 = "";
  if (iaqSensor.run()) { // If new data is available
    Serial.println(output2);     
  } else {
      checkIaqSensorStatus();
  }

  temp = iaqSensor.temperature;
  hume = iaqSensor.humidity;
  pres = iaqSensor.pressure;
  sAQI = iaqSensor.staticIaq;

  oled.clearDisplay();
  oled.setCursor(0, 0);
  oled.println("Tesla Lab Data");
  oled.display();

  // oled.print("T ");
  // oled.print(temp);
  // oled.println(" *C");

  // oled.print("H ");
  // oled.print(hume);
  // oled.println(" %");

  // oled.print("sAQI ");
  // oled.println(sAQI);
  


  // checking values for alarms

  int rojoRGB[3] = {255, 0, 0};
  int celesteRGB[3] = {0, 181, 255};
  
  //checksAlarm(temp, TEMP_MAX, TEMP_MIN, "Temperatura", rojoRGB, celesteRGB);
  //checksAlarm(hume, HUME_MAX, HUME_MIN, "Humedad", rojoRGB, celesteRGB);
  //checksAQI(sAQI, SAQI_MAX, SAQI_MIN);


  int boton_arriba = touchRead(4);
  int boton_derecha = touchRead(15);  
  int boton_abajo = touchRead(33);
  int boton_izquierda = touchRead(2);
  int boton_cancel = touchRead(12);
  int boton_enter = touchRead(13);

  if (boton_cancel < touch_treshold || boton_enter < touch_treshold)
  {
    //displayMenu();
  }
  
  oled.print("ar:");
  oled.print(boton_arriba);
  oled.print(" abaj:");
  oled.println(boton_abajo);
  oled.print("der:");
  oled.print(boton_derecha);
  oled.print(" izq:");
  oled.println(boton_izquierda);
  oled.print("can:");
  oled.print(boton_cancel);
  oled.print(" en:");
  oled.println(boton_enter);

  oled.display();

  delay(200);
}


// Funciones de ayuda en el sensor BME680
void checkIaqSensorStatus(void){
  if (iaqSensor.status != BSEC_OK) {
    if (iaqSensor.status < BSEC_OK) {
      output = "BSEC error code : " + String(iaqSensor.status);
      Serial.println(output);
    } else {
      output = "BSEC warning code : " + String(iaqSensor.status);
      Serial.println(output);
    }
  }

  if (iaqSensor.bme680Status != BME680_OK) {
    if (iaqSensor.bme680Status < BME680_OK) {
      output = "BME680 error code : " + String(iaqSensor.bme680Status);
      Serial.println(output);
    } else {
      output = "BME680 warning code : " + String(iaqSensor.bme680Status);
      Serial.println(output);
    }
  }
}
